## conf/layer.conf
```bitbake
# We have a conf and classes directory, append to BBPATH
BBPATH .= ":${LAYERDIR}"

# We have a recipes directory, add to BBFILES
BBFILES += "${LAYERDIR}/recipes*/*/*.bb ${LAYERDIR}/recipes*/*/*.bbappend"

BBFILE_COLLECTIONS += "meta-altera"
BBFILE_PATTERN_meta-altera := "^${LAYERDIR}/"
# increase the number
BBFILE_PRIORITY_meta-altera = "6"
LAYERSERIES_COMPAT_meta-altera = "warrior zeus dunfell gatesgarth hardknott"
# yves
BBDEBUG = "yes"
```

## conf/machine/10m50.conf
```bitbake
#@TYPE: Machine
#@Name: Altera MAX10 NIOS2 GHRD machine
#@DESCRIPTION: Machine configuration for nios2 machines

require conf/machine/include/tune-nios2.inc

TUNE_FEATURES_append = " hw-div hw-mul"

UBOOT_CONFIG ??= "qspi"
UBOOT_CONFIG[qspi] = "10m50_config"
UBOOT_BINARY = "u-boot-dtb.bin"
UBOOT_ENTRYPOINT = "0xc8000000"
UBOOT_LOADADDRESS = "0xc8000000"

KERNEL_CLASSES += " kernel-fitimage "
KERNEL_IMAGETYPE = "fitImage"
KERNEL_DEVICETREE = "10m50_devboard.dtb"
MACHINE_EXTRA_RRECOMMENDS = "kernel-modules"
MACHINE_FEATURES = "kernel26 serial"

KBUILD_DEFCONFIG ?= "10m50_defconfig"

SERIAL_CONSOLE = "115200 ttyS0"

PREFERRED_PROVIDER_virtual/kernel ??= "linux-altera-ltsi"
PREFERRED_PROVIDER_u-boot ??= "u-boot-socfpga"
```

## conf/machine/agilex.conf
```bitbake
#@TYPE: Machine
#@NAME: Altera Agilex
#@DESCRIPTION: Layer for the Intel PSG Agilex

KBUILD_DEFCONFIG ?= "defconfig"

require conf/machine/include/socfpga_armv8a.inc

UBOOT_CONFIG ??= "agilex-socdk"

KERNEL_DEVICETREE ?= "intel/socfpga_agilex_socdk.dtb"

SERIAL_CONSOLES ?= "115200;ttyS0"

EXTRA_IMAGECMD_jffs2 ?= "-n -q -e 0x10000"

# Add variables for wic creation of sdcard image
IMAGE_BOOT_FILES ?= " \
			${UBOOT_BINARY} \
			${KERNEL_IMAGETYPE} \
			socfpga_agilex_socdk.dtb \
		    "
WKS_FILE ?= "sdimage-stratix10-agilex.wks"
IMAGE_FSTYPES += "wic"
```

## conf/machine/arria10.conf
```bitbake
#@TYPE: Machine
#@NAME: arria10
#@DESCRIPTION: Machine configuration for the Arria 10 SoC" 

require conf/machine/include/socfpga.inc

SPL_BINARY = "u-boot-with-spl.sfp"
UBOOT_BINARY = "u-boot.img"

UBOOT_CONFIG ??= "arria10-socdk"

KMACHINE = "arria10"

# Default kernel devicetrees
KERNEL_DEVICETREE ?= "\
			socfpga_arria10_socdk_sdmmc.dtb \
			socfpga_arria10_socdk_qspi.dtb \
			socfpga_arria10_socdk_nand.dtb \
			"

EXTRA_IMAGECMD_jffs2 ?= "-n -q \
	${@bb.utils.contains("A10_IMAGE_TYPE", "NAND", "-e 0x20000 -s 0x200", "", d)} \
	${@bb.utils.contains("A10_IMAGE_TYPE", "QSPI", "-e 0x10000", "", d)} \
	"

SERIAL_CONSOLES ?= "115200;ttyS0"

UBOOT_EXTLINUX ?= "1"
UBOOT_EXTLINUX_LABELS ?= "default"
UBOOT_EXTLINUX_DEFAULT_LABEL ?= "Arria10 SOCDK SDMMC"

UBOOT_EXTLINUX_MENU_DESCRIPTION_default ?= "Arria10 SOCDK SDMMC"
UBOOT_EXTLINUX_KERNEL_IMAGE_default ?= "../${KERNEL_IMAGETYPE}"
UBOOT_EXTLINUX_FDT_default ?= "../socfpga_arria10_socdk_sdmmc.dtb"
UBOOT_EXTLINUX_KERNEL_ARGS_default ?= "rootwait rw earlycon"
UBOOT_EXTLINUX_ROOT_default ?= "root=/dev/mmcblk0p3"

IMAGE_BOOT_FILES ?= " \
        ${KERNEL_DEVICETREE} \
        ${KERNEL_IMAGETYPE} \
        ${UBOOT_BINARY} \
        extlinux.conf;extlinux/extlinux.conf \
        "

WKS_FILE ?= "sdimage-arria10.wks"
IMAGE_FSTYPES +="wic"
```

## conf/machine/arria5.conf
```bitbake
#@TYPE: Machine
#@NAME: arria5
#@DESCRIPTION: Machine configuration for the Arria V SoC" 

require conf/machine/include/socfpga.inc

UBOOT_CONFIG ??= "arria5-socdk"

KMACHINE = "arria5"

# Default kernel devicetrees
KERNEL_DEVICETREE_arria5 ?= " \
				socfpga_arria5_socdk.dtb \
				"

SERIAL_CONSOLES ?= "115200;ttyS0"

UBOOT_EXTLINUX ?= "1"
UBOOT_EXTLINUX_LABELS ?= "default"
UBOOT_EXTLINUX_DEFAULT_LABEL ?= "Arria5 SOCDK"

UBOOT_EXTLINUX_FDT:default ?= "../socfpga_arria5_socdk.dtb"
UBOOT_EXTLINUX_ROOT:default ?= "root=/dev/mmcblk0p3"
UBOOT_EXTLINUX_MENU_DESCRIPTION:default ?= "Arria5 SOCDK"
UBOOT_EXTLINUX_KERNEL_IMAGE:default ?= "../${KERNEL_IMAGETYPE}"
UBOOT_EXTLINUX_FDTDIR:default ?= "../"
UBOOT_EXTLINUX_KERNEL_ARGS:default ?= "rootwait rw earlycon"

IMAGE_BOOT_FILES ?= " \
        ${KERNEL_DEVICETREE} \
        ${KERNEL_IMAGETYPE} \
        extlinux.conf;extlinux/extlinux.conf \
        "

WKS_FILE ?= "sdimage-cyclone5-arria5.wks"
IMAGE_FSTYPES +="wic"
```

## conf/machine/cyclone5.conf
```bitbake
#@TYPE: Machine
#@NAME: cyclone5
#@DESCRIPTION: Machine configuration for the Cyclone V SoC" 

require conf/machine/include/socfpga.inc

UBOOT_CONFIG ??= "cyclone5-socdk"

KMACHINE = "cyclone5"

# Default kernel devicetrees
KERNEL_DEVICETREE ?= "\
			socfpga_cyclone5_socdk.dtb \
			socfpga_cyclone5_sockit.dtb \
			socfpga_cyclone5_socrates.dtb \
			socfpga_cyclone5_de0_nano_soc.dtb \
			socfpga_cyclone5_mcvevk.dtb \
			socfpga_cyclone5_sodia.dtb \
			socfpga_cyclone5_vining_fpga.dtb \
			"

SERIAL_CONSOLES ?= "115200;ttyS0"

UBOOT_EXTLINUX ?= "1"
UBOOT_EXTLINUX_LABELS ?= "default"
UBOOT_EXTLINUX_DEFAULT_LABEL ?= "Cyclone5 SOCDK SDMMC"

UBOOT_EXTLINUX_FDT_default ?= "../socfpga_cyclone5_socdk.dtb"
UBOOT_EXTLINUX_ROOT_default ?= "root=/dev/mmcblk0p3"
UBOOT_EXTLINUX_MENU_DESCRIPTION_default ?= "Cyclone5 SOCDK SDMMC"
UBOOT_EXTLINUX_KERNEL_IMAGE_default ?= "../${KERNEL_IMAGETYPE}"
UBOOT_EXTLINUX_FDTDIR_default ?= "../"
UBOOT_EXTLINUX_KERNEL_ARGS_default ?= "rootwait rw earlycon"

IMAGE_BOOT_FILES ?= " \
	${KERNEL_DEVICETREE} \
	${KERNEL_IMAGETYPE} \
	extlinux.conf;extlinux/extlinux.conf \
	"

EXTRA_IMAGECMD_jffs2 ?= "-e 0x10000"

WKS_FILE ?= "sdimage-cyclone5-arria5.wks"
IMAGE_FSTYPES +="wic"
```

## conf/machine/generic-nios2.conf
```bitbake
#@TYPE: Machine
#@Name: generic NIOS2 machine
#@DESCRIPTION: Machine configuration for nios2 machines

require conf/machine/include/tune-nios2.inc

MACHINE_FEATURES = "kernel26 serial"

KERNEL_IMAGETYPE = "zImage"
PREFERRED_PROVIDER_virtual/kernel ??= "linux-yocto"
```

## conf/machine/include/nios2/feature-nios2-divide.inc
```bitbake
TUNEVALID[hw-div] = "Enable Nios2 hardware divider."
NIOS2CCARGSDIV = "${@bb.utils.contains("TUNE_FEATURES", "hw-div", "-mhw-div", "" ,d)}"
NIOS2PKGDIV = "${@bb.utils.contains("TUNE_FEATURES", "hw-div", "-div", "" ,d)}"
```

## conf/machine/include/nios2/feature-nios2-fpu.inc
```bitbake
TARGET_FPU = "fpu-other"

TUNEVALID[fpu-soft] = "Use Nios2 software FPU"
TUNEVALID[fpu-custom] = "Enable Nios2 hardware FPU"
TUNEVALID[fpu-customdiv] = "Enable Nios2 hardware FPU with divider"

# Establish which fpu is configured in TUNE_FEATURES. Soft is the default for gcc.
NIOS2CCARGSFPU_BASIC = "${@bb.utils.contains("TUNE_FEATURES", "fpu-custom", "-mcustom-fpu-cfg=60-1", "", d)}"
NIOS2CCARGSFPU = "${@bb.utils.contains("TUNE_FEATURES", "fpu-customdiv", "-mcustom-fpu-cfg=60-2", "${NIOS2CCARGSFPU_BASIC}", d)}"

NIOS2PKGFPU_BASIC = "${@bb.utils.contains("TUNE_FEATURES", "fpu-custom", "-fpu", "", d)}"
NIOS2PKGFPU = "${@bb.utils.contains("TUNE_FEATURES", "fpu-customdiv", "-fpudiv", "${NIOS2PKGFPU_BASIC}", d)}"

TUNECONFLICTS[fpu-custom] = "fpu-soft fpu-customdiv"
TUNECONFLICTS[fpu-customdiv] = "fpu-soft fpu-custom"
```

## conf/machine/include/nios2/feature-nios2-multiply.inc
```bitbake
TUNEVALID[hw-mul] = "Enable Nios2 Hardware Multiply"
TUNEVALID[hw-mulx] = "Enable Nios2 Extended Hardware Multiply"

# Establish which Multiply output result size to use
NIOS2CCARGSMUL = "${@bb.utils.contains("TUNE_FEATURES", "hw-mul", "-mhw-mul", "" ,d)}"
NIOS2CCARGSMUL += "${@bb.utils.contains("TUNE_FEATURES", "hw-mulx", "-mhw-mulx", "" ,d)}"

NIOS2PKGMUL_BASIC = "${@bb.utils.contains("TUNE_FEATURES", "hw-mul", "-mul", "" ,d)}"
NIOS2PKGMUL = "${@bb.utils.contains("TUNE_FEATURES", "hw-mulx", "-mulx", "${NIOS2PKGMUL_BASIC}" ,d)}"
```

## conf/machine/include/socfpga.inc
```bitbake
SOC_FAMILY = "socfpga"

require conf/machine/include/tune-cortexa9.inc

# this variable specifies the kernel to be built: linux-altera or linux-altera-ltsi
# this affects the PREFERRED_PROVIDER of virtual/kernel
# it can be overriden from the environment, using BB_ENV_EXTRAWHITE
KERNEL_PROVIDER ?= "linux-altera-ltsi"
PREFERRED_PROVIDER_virtual/kernel ?= "${KERNEL_PROVIDER}"

PREFERRED_PROVIDER_virtual/bootloader ?= "u-boot-socfpga"

# Increase this everytime you change something in the kernel
MACHINE_KERNEL_PR = "r1"

UBOOT_ENTRYPOINT = "0x80008000"
UBOOT_LOADADDRESS = "0x80008000"

SERIAL_CONSOLE = "115200 ttyS0"

KERNEL_IMAGETYPE = "zImage"
MACHINE_EXTRA_RRECOMMENDS = " kernel-modules"
MACHINE_FEATURES = "kernel26"

# file system images required
IMAGE_FSTYPES ?= "cpio ext3 tar.gz"

# u-boot setup
UBOOT_SUFFIX = "img"

# AV and CV uBoot + SPL mkpimage type binary
SPL_BINARY_cyclone5 = "u-boot-with-spl.sfp"
SPL_BINARY_arria5 = "u-boot-with-spl.sfp"

# Set extlinux.conf up
UBOOT_EXTLINUX ??= "0"
UBOOT_EXTLINUX_ROOT ?= "root=/dev/mmcblk0p2"
UBOOT_EXTLINUX_LABELS ?= "default"
UBOOT_EXTLINUX_CONSOLE ?= "earlycon"
UBOOT_EXTLINUX_MENU_DESCRIPTION_default ?= "Linux Default"
UBOOT_EXTLINUX_KERNEL_IMAGE_default ?= "../${KERNEL_IMAGETYPE}"
UBOOT_EXTLINUX_FDTDIR_default ??= "../"
UBOOT_EXTLINUX_KERNEL_ARGS_default ??= "rootwait rw"

# Add default variables for wic creation of sdcard image
IMAGE_BOOT_FILES ?= " \
	${KERNEL_DEVICETREE} \
	${KERNEL_IMAGETYPE} \
	"

WKS_FILE ?= "sdimage-cyclone5-arria5.wks"
do_image_wic[depends] += "mtools-native:do_populate_sysroot dosfstools-native:do_populate_sysroot virtual/bootloader:do_deploy virtual/kernel:do_deploy"
```

## conf/machine/include/socfpga_armv8a.inc
```bitbake
require conf/machine/include/arm/arch-armv8.inc

KERNEL_PROVIDER ?= "linux-altera"
PREFERRED_PROVIDER_virtual/kernel ?= "${KERNEL_PROVIDER}"
KERNEL_IMAGETYPE = "Image"
MACHINE_EXTRA_RRECOMMENDS += "kernel-modules"

PREFERRED_PROVIDER_virtual/bootloader ?= "u-boot-socfpga"

SPL_BINARY = "spl/u-boot-spl-dtb.hex"
UBOOT_SUFFIX = "img"
UBOOT_BINARY = "u-boot-dtb.img"
UBOOT_IMAGE = "u-boot-dtb-${MACHINE}-${PV}-${PR}.${UBOOT_SUFFIX}"

IMAGE_FSTYPES ?= "cpio ext3 tar.gz"
do_image_wic[depends] += "mtools-native:do_populate_sysroot dosfstools-native:do_populate_sysroot virtual/bootloader:do_deploy virtual/kernel:do_deploy"
```

## conf/machine/include/tune-nios2.inc
```bitbake
#@TYPE: Machine configuration
#@NAME: nios2

DEFAULTTUNE ?= "nios2"

TUNE_ARCH = "nios2el"

# Multiply opcodes
TUNEVALID[hw-mul] = "Enable Nios2 Hardware Multiply"
TUNEVALID[hw-mulx] = "Enable Nios2 Extended Hardware Multiply"

# Establish which Multiply output result size to use
NIOS2CCARGSMUL = "${@bb.utils.contains("TUNE_FEATURES", "hw-mul", "-mhw-mul", "" ,d)}"
NIOS2CCARGSMUL += "${@bb.utils.contains("TUNE_FEATURES", "hw-mulx", "-mhw-mulx", "" ,d)}"

NIOS2PKGMUL_BASIC = "${@bb.utils.contains("TUNE_FEATURES", "hw-mul", "-mul", "" ,d)}"
NIOS2PKGMUL = "${@bb.utils.contains("TUNE_FEATURES", "hw-mulx", "-mulx", "${NIOS2PKGMUL_BASIC}" ,d)}"

# Divide opcodes
TUNEVALID[hw-div] = "Enable Nios2 hardware divider."
NIOS2CCARGSDIV = "${@bb.utils.contains("TUNE_FEATURES", "hw-div", "-mhw-div", "" ,d)}"
NIOS2PKGDIV = "${@bb.utils.contains("TUNE_FEATURES", "hw-div", "-div", "" ,d)}"

# FPU support
TARGET_FPU = "fpu-other"
TUNEVALID[fpu-soft] = "Use Nios2 software FPU"
TUNEVALID[fpu-custom] = "Enable Nios2 hardware FPU"
TUNEVALID[fpu-customdiv] = "Enable Nios2 hardware FPU with divider"

# Establish which fpu is configured in TUNE_FEATURES. Soft is the default for gcc.
NIOS2CCARGSFPU_BASIC = "${@bb.utils.contains("TUNE_FEATURES", "fpu-custom", "-mcustom-fpu-cfg=60-1", "", d)}"
NIOS2CCARGSFPU = "${@bb.utils.contains("TUNE_FEATURES", "fpu-customdiv", "-mcustom-fpu-cfg=60-2", "${NIOS2CCARGSFPU_BASIC}", d)}"

NIOS2PKGFPU_BASIC = "${@bb.utils.contains("TUNE_FEATURES", "fpu-custom", "-fpu", "", d)}"
NIOS2PKGFPU = "${@bb.utils.contains("TUNE_FEATURES", "fpu-customdiv", "-fpudiv", "${NIOS2PKGFPU_BASIC}", d)}"

TUNECONFLICTS[fpu-custom] = "fpu-soft fpu-customdiv"
TUNECONFLICTS[fpu-customdiv] = "fpu-soft fpu-custom"

# Architecture configuration
AVAILTUNES += "nios2"
TUNEVALID[nios2] = "nios2"
TUNE_FEATURES_tune-nios2 += "nios2"

TUNE_CCARGS += "-mel ${NIOS2CCARGSDIV} ${NIOS2CCARGSFPU} ${NIOS2CCARGSMUL}"
TUNE_PKGARCH = "nios2${NIOS2PKGMUL}${NIOS2PKGDIV}${NIOS2PKGFPU}"
PACKAGE_EXTRA_ARCHS_tune-nios2 = "${TUNE_PKGARCH}"
```

## conf/machine/socfpga_arria5.conf
```bitbake
#@TYPE: Machine
#@NAME: SOCFPGA 
#@DESCRIPTION: Machine configuration for the Cyclone V SoC" 

require conf/machine/include/socfpga.inc

UBOOT_MACHINE = "socfpga_arria5"
```

## conf/machine/stratix10.conf
```bitbake
#@TYPE: Machine
#@NAME: Altera Stratix10
#@DESCRIPTION: Layer for the Altera Stratix10

require conf/machine/include/socfpga_armv8a.inc

UBOOT_CONFIG ??= "stratix10-socdk"

KERNEL_DEVICETREE ?= "altera/socfpga_stratix10_socdk.dtb"

SERIAL_CONSOLES ?= "115200;ttyS0"

EXTRA_IMAGECMD_jffs2 ?= "-n -q -e 0x10000"

# Add variables for wic creation of sdcard image
IMAGE_BOOT_FILES ?= " \
			${UBOOT_BINARY} \
			${KERNEL_IMAGETYPE} \
			socfpga_stratix10_socdk.dtb \
		    "
WKS_FILE ?= "sdimage-stratix10-agilex.wks"
IMAGE_FSTYPES += "wic"
```

## conf/machine/stratix10swvp.conf
```bitbake
#@TYPE: Machine
#@NAME: Altera Stratix10 SWVP
#@DESCRIPTION: Layer for the Altera Stratix10 Software Virtual Platform

require conf/machine/include/arm/arch-armv8.inc

PREFERRED_PROVIDER_virtual/xserver ?= "xserver-xorg"

XSERVER ?= "xserver-xorg \
            mesa-driver-swrast \
            xf86-input-evdev \
            xf86-input-mouse \
            xf86-video-fbdev \
            xf86-input-keyboard"

MACHINE_FEATURES = ""

# Don't include kernels in standard images
RDEPENDS_kernel-base = ""

KERNEL_PROVIDER ?= "linux-altera"
PREFERRED_PROVIDER_virtual/kernel ?= "${KERNEL_PROVIDER}"

KERNEL_IMAGETYPE = "Image"

# We have to disable SERIAL_CONSOLE due to auto-serial-console
#SERIAL_CONSOLE = "115200 ttyAMA0"

# Force auto-serial-console to be used by all image types
# Ideally this would be part of core oe or as a bbclassappend,
# but as we don't have an easy way to append a class, defining
# it here
EXTRA_IMAGE_FEATURES += "autoserial"
FEATURE_PACKAGES_autoserial = "auto-serial-console"

# we do not want to have getty running on tty1 as we run
# auto-serial-console there
#USE_VT = "0"
IMAGE_FSTYPES ?= "cpio ext3 tar.gz"
```

## wic/sdimage-arria10.wks
```
# short-description: Create an SD card image for the Arria 10 SoC.
# long-description: Create an SD card image for the Arria 10 SoC.
# Boot files are located in the first vfat partition and u-Boot is located in
# the third partition.

part --source bootimg-partition --ondisk mmcblk --fstype=vfat --label boot --active --align 1024 --size 50M
part --source rawcopy --sourceparams="file=u-boot-with-spl.sfp" --ondisk mmcblk --system-id=a2 --align 1024 --fixed-size 10M
part / --source rootfs --ondisk mmcblk --fstype=ext4 --label root --align 1024
```

## wic/sdimage-cyclone5-arria5.wks
```
# short-description: Create an SD card image for the Cyclone 5 and Arria 5 SoCs
# long-description: Create an SD card image for the Cyclone 5 and Arria 5 SoCs.
# Boot files are located in the first vfat partition and u-Boot is located in
# the third partition.

part --source bootimg-partition --ondisk mmcblk --fstype=vfat --label boot --active --align 1024 --size 16
part --source rawcopy --sourceparams="file=u-boot-with-spl.sfp" --ondisk mmcblk --system-id=a2 --align 1024 --fixed-size 1M
part / --source rootfs --ondisk mmcblk --fstype=ext4 --label root --align 1024
```
